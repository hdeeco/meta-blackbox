## meta-blackbox/conf/machine/blackbox7405.conf
```bitbake
require conf/machine/include/blackbox-oem.inc

PREFERRED_PROVIDER_virtual/kernel = "linux-blackbox"
PREFERRED_VERSION_linux-blackbox = "3.14.21"
PREFERRED_VERSION_linux-libc-headers = "3.14"

MACHINE_FEATURES += "textlcd ci omb dvb-c blindscan-dvbc blindscan-dvbs"

CHIPSET = "bcm7413"

MACHINE_KERNEL_PR = "r5"

MACHINE_ESSENTIAL_EXTRA_RDEPENDS = "\
    blackbox-dvb-modules-blackbox7405 \
    "

MACHINE_EXTRA_RDEPENDS = "\
    rt3070 rt3573 rt5572 rtl8192cu rt8812au \
    enigma2-plugin-drivers-network-usb-rt73 \
    enigma2-plugin-drivers-network-usb-rt3070 \
    enigma2-plugin-drivers-network-usb-rt3573 \
    enigma2-plugin-drivers-network-usb-rt5572 \
    enigma2-plugin-drivers-network-usb-r8712u \
    enigma2-plugin-drivers-network-usb-rtl8192cu \
    "
```
